## config/west.yml
```yaml
# This file specifies the build dependencies for Github Action workflows and
# for local build environments. The workspace has four toplevel directories
# containing the user config, modules, zephy and ZMK.
#
# ZMK-Workspace
# ├── config
# ├── modules
# ├── zephyr
# └── zmk
#
# To create a local build environment, clone this repository and then run the
# following commands from its toplevel directory:
#
# $ west init -l config
# $ west update
# $ west zephyr-export
#
---
manifest:

  remotes:
    - name: zmkfirmware
      url-base: https://github.com/zmkfirmware
    - name: urob
      url-base: https://github.com/urob

  projects:
    - name: zmk
      remote: urob
      revision: v0.2
      import: app/west.yml

    # ZMK modules
    - name: zmk-adaptive-key
      remote: urob
      revision: v0.2
    - name: zmk-auto-layer
      remote: urob
      revision: v0.2

  self:
    path: config
```
